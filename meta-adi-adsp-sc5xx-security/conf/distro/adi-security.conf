## meta-adi-adsp-sc5xx/conf/distro/adi-distro-glibc.conf
```bitbake
require conf/distro/poky.conf
require adi-distro-shared.conf

DISTRO = "adi-distro-glibc"
DISTRO_NAME = "Analog Devices Inc Reference Distro (glibc)"

TARGET_VENDOR = "-adi_glibc"
SDK_VENDOR = "-adi_glibc_sdk"

DISTRO_FEATURES:remove = "sysvinit"
DISTRO_FEATURES:append = " systemd"
DISTRO_FEATURES_OPTED_OUT = "sysvinit"
VIRTUAL-RUNTIME_dev_manager = "udev"
VIRTUAL-RUNTIME_init_manager = "systemd"
VIRTUAL-RUNTIME_login_manager = "systemd"

DISTRO_FEATURES_FILTER_NATIVE:append = " systemd"
DISTRO_FEATURES_NATIVE:remove = "sysvinit"
DISTRO_FEATURES_NATIVE:append = " systemd"

DISTRO_FEATURES_FILTER_NATIVESDK:append = " systemd"
DISTRO_FEATURES_NATIVESDK:remove = "sysvinit"
DISTRO_FEATURES_NATIVESDK:append = " systemd"

INIT_MANAGER = "systemd"
```

## meta-adi-adsp-sc5xx/conf/machine/adsp-sc573-ezlite.conf
```bitbake
require conf/machine/include/adsp-sc5xx.inc

LDR_PROC = "SC573"
LDR_BCODE ?= "2"

MACHINE_EXTRA_RDEPENDS = "adsp-boot"

MACHINE_FEATURES += " spl "

BASH_HAS_SPL = "1"

UBOOT_MACHINE = "sc573-ezlite_defconfig"
UBOOT_ENTRYPOINT = "0x84008000"
UBOOT_LOADADDRESS = "0x84008000"
UBOOT_DTBADDRESS = "0x84000000"
UBOOT_RDADDR = "0x85000000"

KERNEL_DEVICETREE = "adi/sc573-ezlite.dtb"

SERIAL_CONSOLES ?= "115200;ttySC0"

MMC_BOOT_STAGE1 = "u-boot-spl.ldr"
MMC_BOOT_STAGE2 = "u-boot.ldr"

IMAGE_FSTYPES = "wic.gz"
WKS_FILE = "adsp-sc5xx-mmc.wks.in"
WKS_DTB = "sc573-ezlite.dtb"

MACHINE_EXTRA_RRECOMMENDS = "kernel-modules"
BOARD = "sc573-ezlite"

MKUBIFS_ARGS = "-m 1 -e 65408 -c 550"

FLASH_UBOOT_OFFSET = "0x20000"
FLASH_KERNEL_OFFSET = "0xd0000"
FLASH_ROOTFS_OFFSET = "0x6e0000"
```

## meta-adi-adsp-sc5xx/conf/machine/adsp-sc846-som-ezkit.conf
```bitbake
require conf/machine/include/adsp-sc598-som.inc

# Do not modify below here

# Parameters for ADI LDR tool if a recipe needs them
LDR_PROC = "SC846"
LDR_BCODE ?= "2"

MACHINE_EXTRA_RDEPENDS = "adsp-boot"

MMC_BOOT_STAGE1 = "stage1-boot.ldr"
MMC_BOOT_STAGE2 = "stage2-boot.ldr"

UBOOT_MACHINE = "sc846-som_defconfig"

UBOOT_ENTRYPOINT = "0x9a200000"
UBOOT_LOADADDRESS = "0x9a200000"
UBOOT_DTBADDRESS = "0x99000000"
UBOOT_RDADDR = "0x9c000000"

KERNEL_DEVICETREE = "adi/sc846-som-ezkit.dtb"

SERIAL_CONSOLES ?= "115200;ttySC0"

IMAGE_FSTYPES = "wic.gz"
WKS_FILE = "adsp-sc5xx.wks.in"
WKS_DTB = "sc846-som-ezkit.dtb"

IMAGE_INSTALL += "mtd-utils-ubifs mtd-utils-jffs2"

EXTRA_IMAGECMD:jffs2 = "--pad --little-endian --eraseblock=0x10000 --no-cleanmarkers"

MACHINE_EXTRA_RRECOMMENDS = "kernel-modules"
BOARD = "sc846-som-ezkit"
```
