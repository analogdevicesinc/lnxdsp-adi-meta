OUTPUT_FORMAT("REPLACE_OUTPUT_FORMAT")
OUTPUT_ARCH(REPLACE_OUTPUT_ARCH)
ENTRY(_start)
MEMORY {
	RAM (rwx): ORIGIN = LOAD_ADDRESS, LENGTH = 0x0010001c
}
SECTIONS
{
	. = LOAD_ADDRESS;
	_start = .;
	.text . : {
		*tee.o(.data*)
		. = ALIGN(4);
	} >RAM
	/DISCARD/ : {
		*(.dynsym .dynamic .interp .note.gnu.build-id)
	}
}
