## conf/distro/adi-distro.conf
```bitbake
require conf/distro/poky.conf

DISTRO_FEATURES_remove = ""

DISTRO_FEATURES_append = ""
```

## conf/layer.conf
```bitbake
# We have a conf and classes directory, add to BBPATH
BBPATH .= ":${LAYERDIR}"

# We have a recipes-* directories, add to BBFILES
BBFILES += " \
	${LAYERDIR}/recipes-*/*/*.bb \
	${LAYERDIR}/recipes-*/*/*.bbappend \
"

BBFILE_PATTERN_formlabs = "^${LAYERDIR}/"
BBFILE_PRIORITY_formlabs = "6"
```

## conf/machine/adsp-sc584-ezkit.conf
```bitbake
require conf/machine/include/adsp-sc5xx.inc

UBOOT_MACHINE = "..._defconfig"
UBOOT_ENTRYPOINT = "0x80008000"
UBOOT_LOADADDRESS = "0x80008000"

SERIAL_CONSOLE ?= "115200 ttyS0"

IMAGE_FSTYPES = "tar.xz"

MACHINE_EXTRA_RRECOMMENDS = "kernel-modules"
```

## meta-adi-adsp-sc5xx-security/conf/layer.conf
```bitbake
# We have a conf and classes directory, add to BBPATH
BBPATH .= ":${LAYERDIR}"

# We have a recipes-* directories, add to BBFILES
BBFILES += " \
	${LAYERDIR}/recipes-*/*/*.bb \
	${LAYERDIR}/recipes-*/*/*.bbappend \
"

LAYERDEPENDS_adsp-sc5xx-security = " \
	adsp-sc5xx \
	meta-arm \
"
BBFILE_COLLECTIONS += "adsp-sc5xx-security"
BBFILE_PATTERN_adsp-sc5xx-security = "^${LAYERDIR}/"
BBFILE_PRIORITY_adsp-sc5xx-security = "6"

LAYERSERIES_COMPAT_adsp-sc5xx-security = "scarthgap"
```

## meta-adi-adsp-sc5xx/conf/distro/adi-distro.conf
```bitbake
require conf/distro/poky-tiny.conf

LTO:pn-musl = ""
LTO:pn-glibc = ""
LTO:pn-gcc-runtime = ""
LTO:pn-libgcc-initial = ""
LTO:pn-libgcc = ""
LTO:pn-perl = ""
LTO:pn-alsa-lib = ""
LTO:pn-libaio = ""
LTO:pn-lua = ""
LTO:pn-sqlite = ""
LTO:pn-ltrace = ""
LTO:pn-linuxptp = ""
LTO:pn-ltp = ""
LTO:pn-perf = ""
LTO:pn-uftrace = ""
LTO:pn-lttng-ust = ""
LTO ?= "-flto"

SELECTED_OPTIMIZATION:append:class-target = " ${LTO}"
TARGET_LDFLAGS:append:class-target = " ${LTO}"
SELECTED_OPTIMIZATION[vardeps] += "LTO"

DISTRO = "adi-distro"
DISTRO_NAME = "Analog Devices Inc Reference Distro"
DISTRO_VERSION = "3.0.0"

TARGET_VENDOR = "-adi"
SDK_VENDOR = "-adisdk"

DISTRO_FEATURES:remove = "sysvinit"

DISTRO_FEATURES:append = " systemd"
DISTRO_FEATURES_BACKFILL_CONSIDERED = "sysvinit"
VIRTUAL-RUNTIME_dev_manager = "udev"
VIRTUAL-RUNTIME_init_manager = "systemd"
VIRTUAL-RUNTIME_initscripts = "systemd-compat-units"
VIRTUAL-RUNTIME_login_manager = "systemd"

DISTRO_FEATURES_FILTER_NATIVE:append = " systemd"
DISTRO_FEATURES_NATIVE:remove = "sysvinit"
DISTRO_FEATURES_NATIVE:append = " systemd"

DISTRO_FEATURES_FILTER_NATIVESDK:append = " systemd"
DISTRO_FEATURES_NATIVESDK:remove = "sysvinit"
DISTRO_FEATURES_NATIVESDK:append = " systemd"

PREFERRED_PROVIDER_virtual/kernel = "linux-adi"

INIT_MANAGER = "systemd"
```

## meta-adi-adsp-sc5xx/conf/distro/adi-security.conf
```bitbake
require conf/distro/adi-distro-glibc.conf

DISTRO = "adi-security"

DISTRO_FEATURES:append = " optee"
DISTRO_FEATURES:append = " signedboot"

LTO:pn-optee-os = ""
LTO:pn-optee-client = ""
LTO:pn-optee-test = ""
LTO:pn-libadiotp = ""
LTO:pn-libopteesharc = ""
LTO:pn-optee-examples = ""

# adsp-signed-boot will automatically use optee-os; optee-test will include
# the optee-os-dev package as necessary
DISTRO_EXTRA_RDEPENDS = "adsp-signed-boot optee-client optee-test libadiotp libopteesharc optee-examples"
IMAGE_INSTALL:append = " optee-os-ta"

# This is the actual load address less 0x1c to account for the optee header
OPTEE_LOAD_ADDRESS ?= "0x9eefffe4"

# Actual start address in the middle of it, used for the optee shim that jumps to it
# when TFA is not available
OPTEE_START_ADDRESS ?= "0xcef00000"

require conf/distro/include/adsp-sc5xx-security.inc
```

## meta-adi-adsp-sc5xx/conf/distro/include/adsp-sc5xx-security.inc
```bitbake
# Based on distro features selected in the distro definition, enable overrides that will control
# the behavior of other recipes

DISTROOVERRIDES = "${@bb.utils.contains('DISTRO_FEATURES', 'optee', ':adsp-sc5xx-optee', '', d)}${@bb.utils.contains('DISTRO_FEATURES', 'signedboot', ':adsp-sc5xx-signedboot', '', d)}"
DISTROOVERRIDES:append = "${@bb.utils.contains('DISTRO_FEATURES', 'optee-shim', ':optee-shim', '', d)}"

BASH_HAS_SECUREBOOT = "${@bb.utils.contains('DISTRO_FEATURES', 'signedboot', '1', '', d)}"
```

## meta-adi-adsp-sc5xx/conf/layer.conf
```bitbake
# We have a conf and classes directory, add to BBPATH
BBPATH .= ":${LAYERDIR}"

# We have a recipes-* directories, add to BBFILES
BBFILES += " \
	${LAYERDIR}/recipes-*/*/*.bb \
	${LAYERDIR}/recipes-*/*/*.bbappend \
"

BBFILE_COLLECTIONS += "adsp-sc5xx"
BBFILE_PATTERN_adsp-sc5xx = "^${LAYERDIR}/"
BBFILE_PRIORITY_adsp-sc5xx = "6"

# meta-arm is required by the security recipes merged in from the former
# meta-adi-adsp-sc5xx-security layer (e.g. trusted-firmware-a)
LAYERDEPENDS_adsp-sc5xx = " meta-arm"

LAYERSERIES_COMPAT_adsp-sc5xx = "scarthgap"
```

## meta-adi-adsp-sc5xx/conf/machine/adsp-sc573-ezkit.conf
```bitbake
require conf/machine/include/adsp-sc5xx.inc

#LDR_PROC = "SC573"
#LDR_BCODE ?= "2"
#
#MACHINE_EXTRA_RDEPENDS = "adsp-boot"

UBOOT_MACHINE = "sc573-ezkit_defconfig"
UBOOT_ENTRYPOINT = "0x80008000"
UBOOT_LOADADDRESS = "0x80008000"
UBOOT_DTBADDRESS = "0x80000000"

KERNEL_DEVICETREE = "sc573-ezkit.dtb"

SERIAL_CONSOLES ?= "115200;ttySC0"

IMAGE_FSTYPES = "tar.xz jffs2"

MACHINE_EXTRA_RRECOMMENDS = "kernel-modules"
BOARD = "sc573-ezkit"
```

## meta-adi-adsp-sc5xx/conf/machine/adsp-sc584-ezkit.conf
```bitbake
require conf/machine/include/adsp-sc5xx.inc

LDR_PROC = "SC589"
LDR_BCODE ?= "2"

MACHINE_EXTRA_RDEPENDS = "adsp-boot"

MACHINE_FEATURES += " spl "

BASH_HAS_SPL = "1"

UBOOT_MACHINE = "sc584-ezkit_defconfig"
UBOOT_ENTRYPOINT = "0x80008000"
UBOOT_LOADADDRESS = "0x80008000"
UBOOT_DTBADDRESS = "0x80000000"
UBOOT_RDADDR = "0x8C000000"

KERNEL_DEVICETREE = "sc584-ezkit.dtb"

SERIAL_CONSOLES ?= "115200;ttySC0"

IMAGE_FSTYPES = "tar.xz jffs2"

MACHINE_EXTRA_RRECOMMENDS = "kernel-modules"
BOARD = "sc584-ezkit"

EXTRA_IMAGECMD:jffs2 = "--pad=0x920000 --little-endian --eraseblock=0x10000 --no-cleanmarkers"
```

## meta-adi-adsp-sc5xx/conf/machine/adsp-sc589-ezkit.conf
```bitbake
require conf/machine/include/adsp-sc5xx.inc

UBOOT_MACHINE = "sc589-ezkit_defconfig"
UBOOT_ENTRYPOINT = "0x80008000"
UBOOT_LOADADDRESS = "0x80008000"

KERNEL_DEVICETREE = "sc589-ezkit.dtb"

SERIAL_CONSOLE ?= "115200 ttySC0"
SERIAL_CONSOLES ?= "57600;ttySC0"

IMAGE_FSTYPES = "tar.xz"

MACHINE_EXTRA_RRECOMMENDS = "kernel-modules"
BOARD = "sc589-ezkit"
```

## meta-adi-adsp-sc5xx/conf/machine/adsp-sc589-mini-rev21.conf
```bitbake
require conf/machine/include/adsp-sc5xx.inc
require conf/machine/include/adsp-sc589.inc

REV="2.1"
```

## meta-adi-adsp-sc5xx/conf/machine/adsp-sc589-mini.conf
```bitbake
require conf/machine/include/adsp-sc5xx.inc

LDR_PROC = "SC589"
LDR_BCODE ?= "2"

MACHINE_EXTRA_RDEPENDS = "adsp-boot"

MACHINE_FEATURES += " spl "

BASH_HAS_SPL = "1"

UBOOT_MACHINE = "sc589-mini_defconfig"
UBOOT_ENTRYPOINT = "0xC4008000"
UBOOT_LOADADDRESS = "0xC4008000"
UBOOT_DTBADDRESS = "0xC4000000"
UBOOT_RDADDR = "0xC5000000"

#Hardware revision
BRD_REV ?= "2.1"

KERNEL_DEVICETREE = "adi/sc589-mini.dtb"

SERIAL_CONSOLES ?= "115200;ttySC0"

MMC_BOOT_STAGE1 = "u-boot-spl.ldr"
MMC_BOOT_STAGE2 = "u-boot.ldr"

IMAGE_FSTYPES = "tar.xz ubifs wic.gz ext4"
WKS_FILE = "adsp-sc5xx.wks.in"

MACHINE_EXTRA_RRECOMMENDS = "kernel-modules"
BOARD = "sc589-mini"

MKUBIFS_ARGS = "-m 1 -e 65408 -c 882"
```

## meta-adi-adsp-sc5xx/conf/machine/adsp-sc594-som-ezkit.conf
```bitbake
require conf/machine/include/adsp-sc5xx.inc

#Using the SPL is highly suggested, the non-SPL path is considered legacy/deprecated

# Not using SPL, comment SPL and falcon sections

# Using SPL, uncomment spl line below
MACHINE_FEATURES:append = " spl"

# Using Falcon Mode SPL, uncomment falcon line below and comment out spl above
#MACHINE_FEATURES:append = " falcon"

# Do not modify below here

# Parameters for ADI LDR tool if a recipe needs them
LDR_PROC = "SC594"
LDR_BCODE ?= "2"

MACHINE_EXTRA_RDEPENDS = "adsp-boot"

UBOOT_DEF_SUFFIX := "${@bb.utils.contains('MACHINE_FEATURES', 'spl', '-spl', '', d)}"
UBOOT_DEF_SUFFIX := "${@bb.utils.contains('MACHINE_FEATURES', 'falcon', '-falcon', '${UBOOT_DEF_SUFFIX}', d)}"
UBOOT_MACHINE = "sc594-som-ezkit${UBOOT_DEF_SUFFIX}_defconfig"

# use with -n "${BASH_HAS_SPL}" to test for spl build, which also includes falcon boot
# or with -z to check for not spl build
BASH_HAS_SPL = "${@bb.utils.contains_any('MACHINE_FEATURES', 'spl falcon', '1', '', d)}"
BASH_HAS_SPL_ONLY = "${@bb.utils.contains('MACHINE_FEATURES', 'spl', '1', '', d)}"
BASH_HAS_FALCON_ONLY = "${@bb.utils.contains('MACHINE_FEATURES', 'falcon', '1', '', d)}"

UBOOT_ENTRYPOINT = "0x80008000"
UBOOT_LOADADDRESS = "0x80008000"
UBOOT_DTBADDRESS = "0x80000000"
UBOOT_RDADDR = "0x85000000"

KERNEL_DEVICETREE = "sc594-som-ezkit.dtb"

SERIAL_CONSOLES ?= "115200;ttySC0"

IMAGE_FSTYPES = "tar.xz jffs2"

IMAGE_INSTALL += "mtd-utils-ubifs mtd-utils-jffs2"

#Booting from OSPI (IS25LX256) -- 128KB eraseblock:
EXTRA_IMAGECMD:jffs2 = "--pad --little-endian --eraseblock=0x20000 --no-cleanmarkers"

#Booting from QSPI (IS25LP512) -- 64KB eraseblock:
#EXTRA_IMAGECMD:jffs2 = "--pad --little-endian --eraseblock=0x10000 --no-cleanmarkers"

MACHINE_EXTRA_RRECOMMENDS = "kernel-modules"
BOARD = "sc594-som-ezkit"
```

## meta-adi-adsp-sc5xx/conf/machine/adsp-sc598-som-ezkit-testing.conf
```bitbake
require conf/machine/adsp-sc598-som-ezkit.conf

# Make every recipe override that targets the stock machine
# (e.g. SRC_URI:append:adsp-sc598-som-ezkit) also apply to this machine.
MACHINEOVERRIDES =. "adsp-sc598-som-ezkit:"

# Reuse the stock machine's prebuilt RPMsg echo core images (which are named
# per-machine) rather than requiring boottrace-specific copies.
RPMSG_ECHO_MACHINE = "adsp-sc598-som-ezkit"

IMAGE_INSTALL:append = " gpio-boot-trace"
```

## meta-adi-adsp-sc5xx/conf/machine/adsp-sc598-som-ezkit.conf
```bitbake
require conf/machine/include/adsp-sc598-som-ezkit.inc

#Using the SPL is highly suggested, the non-SPL path is considered legacy/deprecated

#Not using SPL -- use below, uncomment 3 line below
#UBOOT_MACHINE = "sc598-som-ezkit_defconfig"
#MMC_BOOT_STAGE1 = "u-boot-sc598-som-ezkit.ldr.emmc_boot_stage1"
#MMC_BOOT_STAGE2 = "u-boot-sc598-som-ezkit.ldr.emmc_boot_stage2"

#Using SPL -- use below, otherwise comment out 4 lines below
UBOOT_MACHINE = "sc598-som-ezkit-spl_defconfig"
SPL_BINARY = "1"
MMC_BOOT_STAGE1 = "u-boot-spl-sc598-som-ezkit.ldr"
MMC_BOOT_STAGE2 = "u-boot-proper-sc598-som-ezkit.img"

#Using Falcon Mode SPL -- use below, otherwise comment out 4 lines below
#UBOOT_MACHINE = "sc598-som-ezkit-falcon_defconfig"
#SPL_BINARY = "1"
#MMC_BOOT_STAGE1 = "u-boot-spl-sc598-som-ezkit.ldr"
#MMC_BOOT_STAGE2 = "u-boot-proper-sc598-som-ezkit.img"

UBOOT_ENTRYPOINT = "0x80008000"
UBOOT_LOADADDRESS = "0x80008000"

KERNEL_DEVICETREE += "adi/sc598-som-ezkit.dtb"

SERIAL_CONSOLE ?= "57600 ttySC0"
SERIAL_CONSOLES ?= "57600;ttySC0"

IMAGE_FSTYPES = "tar.xz jffs2 wic.gz ext4"

WKS_FILE="adsp-sc598.wks.in"

IMAGE_INSTALL += "mtd-utils-ubifs mtd-utils-jffs2"

EXTRA_IMAGECMD_jffs2 = "--pad --little-endian --eraseblock=0x10000 --no-cleanmarkers"

MACHINE_EXTRA_RRECOMMENDS = "kernel-modules"
BOARD = "sc598-som-ezkit"
```

## meta-adi-adsp-sc5xx/conf/machine/adsp-sc598-som-ezlite.conf
```bitbake
require conf/machine/include/adsp-sc598-som.inc

#Using the SPL is highly suggested, the non-SPL path is considered legacy/deprecated

# Not using SPL, comment SPL and falcon sections

# Using SPL, uncomment spl line below
MACHINE_FEATURES:append = " spl"

# Using Falcon Mode SPL, uncomment falcon line below and comment out spl above
#MACHINE_FEATURES:append = " falcon"

# Do not modify below here

# Parameters for ADI LDR tool if a recipe needs them
LDR_PROC = "SC598"
LDR_BCODE ?= "2"

MACHINE_EXTRA_RDEPENDS = "adsp-boot"

MMC_BOOT_STAGE1 = "stage1-boot.ldr"
MMC_BOOT_STAGE2 = "stage2-boot.ldr"

UBOOT_DEF_SUFFIX := "${@bb.utils.contains('MACHINE_FEATURES', 'spl', '-spl', '', d)}"
UBOOT_DEF_SUFFIX := "${@bb.utils.contains('MACHINE_FEATURES', 'falcon', '-falcon', '${UBOOT_DEF_SUFFIX}', d)}"
UBOOT_MACHINE = "sc598-som-ezlite${UBOOT_DEF_SUFFIX}_defconfig"

# use with -n "${BASH_HAS_SPL}" to test for spl build, which also includes falcon boot
# or with -z to check for not spl build
BASH_HAS_SPL = "${@bb.utils.contains_any('MACHINE_FEATURES', 'spl falcon', '1', '', d)}"
BASH_HAS_SPL_ONLY = "${@bb.utils.contains('MACHINE_FEATURES', 'spl', '1', '', d)}"
BASH_HAS_FALCON_ONLY = "${@bb.utils.contains('MACHINE_FEATURES', 'falcon', '1', '', d)}"

UBOOT_ENTRYPOINT = "0x9a080000"
UBOOT_LOADADDRESS = "0x9a080000"
UBOOT_DTBADDRESS = "0x99000000"
UBOOT_RDADDR = "0x9c000000"

KERNEL_DEVICETREE = "adi/sc598-som-ezlite.dtb"

SERIAL_CONSOLES ?= "115200;ttySC0"

IMAGE_FSTYPES = "tar.xz jffs2 wic.gz ext4"
WKS_FILE = "adsp-sc5xx.wks.in"

IMAGE_INSTALL += "mtd-utils-ubifs mtd-utils-jffs2"

EXTRA_IMAGECMD:jffs2 = "--pad --little-endian --eraseblock=0x10000 --no-cleanmarkers"

MACHINE_EXTRA_RRECOMMENDS = "kernel-modules"
BOARD = "sc598-som-ezlite"
```

## meta-adi-adsp-sc5xx/conf/machine/include/adsp-sc598-som.inc
```bitbake
SOC_FAMILY:append = ":adsp-sc5xx"
SOC_FAMILY = "adi-soc"

require conf/machine/include/soc-family.inc
require tune-cortexa55.inc

# Increase this everytime you change something in the kernel
MACHINE_KERNEL_PR = "r0"

KERNEL_IMAGETYPE = "Image.gz"

PREFERRED_PROVIDER_virtual/kernel = "linux-adi"
PREFERRED_PROVIDER_virtual/bootloader = "u-boot-adi"

EXTRA_IMAGEDEPENDS += "virtual/bootloader"

MACHINE_FEATURES = "kernel26 serial ethernet usbhost usbgadget mmc alsa watchdog"
```

## meta-adi-adsp-sc5xx/conf/machine/include/adsp-sc5xx.inc
```bitbake
SOC_FAMILY:append = ":adsp-sc5xx"
SOC_FAMILY = "adi-soc"

require conf/machine/include/soc-family.inc
require conf/machine/include/arm/armv7a/tune-cortexa5.inc

# Increase this everytime you change something in the kernel
MACHINE_KERNEL_PR = "r0"

KERNEL_IMAGETYPE = "zImage"
KERNEL_COMPRESSION = "none"

PREFERRED_PROVIDER_virtual/kernel = "linux-adi"
PREFERRED_PROVIDER_virtual/bootloader = "u-boot-adi"

EXTRA_IMAGEDEPENDS += "virtual/bootloader"

MACHINE_FEATURES = "kernel26 serial ethernet usbhost usbgadget mmc alsa"
```

## meta-adi-external-toolchain/conf/distro/include/tcmode-external-adi.inc
```bitbake
require tcmode-external.inc

#Modify path as necessary
EXTERNAL_TOOLCHAIN = "/opt/analog/cces-linux-add-in/1.3.1/ARM/arm-linux-gnueabi"
EXTERNAL_TOOLCHAIN_BAREMETAL = "/opt/analog/cces/2.8.3/ARM/arm-none-eabi/bin"

#Set to your machine, looks like possibilities in the precompiled chains are:
#  sc589_rev_any, sc573_rev_any, sc589_rev_none, sc573_rev_none
ANALOG_DEVICES_PLATFORM_LIBDIR = "sc589_rev_any"

GLIBC_GENERATE_LOCALES = "en_US.UTF-8"
SECURITY_STACK_PROTECTOR_remove = "-fstack-protector-strong"
OLDEST_KERNEL = "4.4.0"
```
